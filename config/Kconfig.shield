## config/Kconfig.shield
```kconfig
config SHIELD_DOLOMITY_LEFT
    def_bool $(shields_list_contains, dolimity_left)

    config SHIELD_DOLOMITY_RIGHT
    def_bool $(shields_list_contains, dolimity_right)
```

## config/boards/shields/dolomity/Kconfig.defconfig
```kconfig
if SHIELD_DOLOMITY_LEFT

config ZMK_KEYBOARD_NAME
    default "Dolimity"

config ZMK_SPLIT_ROLE_CENTRAL
    default y

endif

if SHIELD_DOLOMITY_LEFT || SHIELD_DOLOMITY_RIGHT

config ZMK_SPLIT
    default y

endif
```

## config/boards/shields/dolomity/Kconfig.shield
```kconfig
config SHIELD_DOLOMITY_LEFT
    def_bool $(shields_list_contains,dolomity_left)

    config SHIELD_DOLOMITY_RIGHT
    def_bool $(shields_list_contains,dolomity_right)
```

## config/west.yml
```yaml
manifest:
  remotes:
    - name: zmkfirmware
      url-base: https://github.com/zmkfirmware
  projects:
    - name: zmk
      remote: zmkfirmware
      revision: main
      import: app/west.yml
  self:
    path: config

#west build -b nice_nano -- -DSHIELD=dolomity_left -DZMK_CONFIG="C:\Users\super\zmk-config-splitkb_dolomity\config"
```
